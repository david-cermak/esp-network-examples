## ascon/components/crypto_aead/Kconfig
```kconfig
menu "Crypto AEAD"

choice AEAD_IMPL
    prompt "Select AEAD implementation"
    default AEAD_IMPL_ASCON
    help
        Choose which AEAD algorithm/provider to use for the demo.

config AEAD_IMPL_ASCON
    bool "Ascon-128 AEAD (ascon-c)"

config AEAD_IMPL_AES_GCM
    bool "AES-GCM-128 (mbedTLS)"

config AEAD_IMPL_CHACHA20_POLY1305
    bool "ChaCha20-Poly1305 (mbedTLS)"

config AEAD_IMPL_MOCK
    bool "Mock (insecure)"

endchoice

endmenu
```

## ascon/sender/sdkconfig.defaults
```kconfig
CONFIG_MBEDTLS_POLY1305_C=y
CONFIG_MBEDTLS_CHACHAPOLY_C=y
CONFIG_MBEDTLS_CHACHA20_C=y
CONFIG_AEAD_IMPL_CHACHA20_POLY1305=y
```

## devcon22/demo_2_netifs/sta_to_eth/sdkconfig.defaults
```kconfig
CONFIG_LWIP_IP_FORWARD=y
CONFIG_LWIP_IPV4_NAPT=y
CONFIG_EXAMPLE_USE_INTERNAL_ETHERNET=y
CONFIG_EXAMPLE_ETH_PHY_IP101=y
# CONFIG_EXAMPLE_ETH_PHY_RTL8201 is not set
# CONFIG_EXAMPLE_ETH_PHY_LAN87XX is not set
# CONFIG_EXAMPLE_ETH_PHY_DP83848 is not set
# CONFIG_EXAMPLE_ETH_PHY_KSZ8041 is not set
# CONFIG_EXAMPLE_ETH_PHY_KSZ8081 is not set
CONFIG_EXAMPLE_ETH_MDC_GPIO=23
CONFIG_EXAMPLE_ETH_MDIO_GPIO=18
CONFIG_EXAMPLE_ETH_PHY_RST_GPIO=5
CONFIG_EXAMPLE_ETH_PHY_ADDR=1
# CONFIG_EXAMPLE_USE_SPI_ETHERNET is not set
```

## lwip_output_hooks/tcp_client/main/Kconfig.projbuild
```kconfig
menu "Example Configuration"

    choice EXAMPLE_IP_MODE
        prompt "IP Version"
        depends on EXAMPLE_SOCKET_IP_INPUT_STRING
        help
            Example can use either IPV4 or IPV6.

        config EXAMPLE_IPV4
            bool "IPV4"

        config EXAMPLE_IPV6
            bool "IPV6"

    endchoice

    config EXAMPLE_IPV4_ADDR
        string "IPV4 Address"
        default "192.168.0.165"
        depends on EXAMPLE_IPV4
        help
            The example will connect to this IPV4 address.

    config EXAMPLE_IP4_OUTPUT_DROP_TCP
        bool "Drop outbound TCP via ip4_output_if linker wrap (demo)"
        depends on EXAMPLE_IPV4
        default n
        help
            When enabled, the linker-wrapped ip4_output_if() drops all outbound TCP
            packets by returning ERR_RTE (the pbuf is not freed here; lwIP callers
            own cleanup). Useful to verify the wrap is active (connect/send will fail).
            Leave disabled for normal TCP client operation.

    config EXAMPLE_IPV6_ADDR
        string "IPV6 Address"
        default "FE80::30AD:E57B:C212:68AD"
        depends on EXAMPLE_IPV6
        help
            The example will connect to this IPV6 address.

    config EXAMPLE_IP6_OUTPUT_DROP_TCP
        bool "Drop outbound TCP via ip6_output_if linker wrap (demo)"
        depends on EXAMPLE_IPV6
        default n
        help
            When enabled, the linker-wrapped ip6_output_if() drops all outbound TCP
            packets by returning ERR_RTE (the pbuf is not freed here; lwIP callers
            own cleanup). Useful to verify the wrap is active (connect/send will fail).
            Leave disabled for normal TCP client operation.

    config EXAMPLE_PORT
        int "Port"
        range 0 65535
        default 3333
        help
            The remote port to which the client example will connect to.

    choice EXAMPLE_INTERFACE
        prompt "Interface selection"
        depends on EXAMPLE_IPV6
        help
            Example can use either "Auto" or "User specified".

        config EXAMPLE_IFACE_AUTO
            bool "Auto"

        config EXAMPLE_USER_SPECIFIED_IFACE
            bool "User specified interface"
    endchoice

    config EXAMPLE_USER_SPECIFIED_IFACE_NAME
        string "User specified interface name"
        default "st1"
        depends on EXAMPLE_USER_SPECIFIED_IFACE
        help
            This interface will be used for communication.

    choice EXAMPLE_SOCKET_IP_INPUT
        prompt "Socket example source"
        default EXAMPLE_SOCKET_IP_INPUT_STRING
        help
            Selects the input source of the IP used in the example.

        config EXAMPLE_SOCKET_IP_INPUT_STRING
            bool "From string"

        config EXAMPLE_SOCKET_IP_INPUT_STDIN
            bool "From stdin"
    endchoice

endmenu
```
